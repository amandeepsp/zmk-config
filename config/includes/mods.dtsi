// vim: ft=dts

/ {
    behaviors {
        // urob's timeless home row mods - https://github.com/urob/zmk-config?tab=readme-ov-file#timeless-homerow-mods
        hml: homerow_mods_left {
             compatible = "zmk,behavior-hold-tap";
             label = "HOMEROW_MODS_LEFT";
             #binding-cells = <2>;
             bindings = <&kp>, <&kp>;
             flavor = "balanced";
             tapping-term-ms = <280>;
             quick-tap-ms = <175>;
             require-prior-idle = <150>;
             hold-trigger-key-positions = <KEYS_L>;
             hold-trigger-on-release;
        };

        hmr: homerow_mods_right {
             compatible = "zmk,behavior-hold-tap";
             label = "HOMEROW_MODS_RIGHT";
             #binding-cells = <2>;
             bindings = <&kp>, <&kp>;
             flavor = "balanced";
             tapping-term-ms = <280>;
             quick-tap-ms = <175>;
             require-prior-idle = <150>;
             hold-trigger-key-positions = <KEYS_R>;
             hold-trigger-on-release;
        };
    };
};
